## poky/meta-squeezeos/conf/machine/fab4.conf
```bitbake
#@TYPE: Machine
#@NAME: Logitech Squeezebox Controller (Jive)
#@DESCRIPTION: Machine configuration for the Logitech Squeezebox Controller
TARGET_ARCH = "arm"
PACKAGE_EXTRA_ARCHS = "armv4 armv4t armv5te armv6"

# Enable thumb for fab4
ARM_INSTRUCTION_SET = "thumb"
THUMB_INTERWORK = "yes"
TARGET_CC_KERNEL_ARCH = "-mthumb-interwork -mno-thumb"

# Need to use -Os rather than the default -O2
FULL_OPTIMIZATION = "-Os -fexpensive-optimizations -fomit-frame-pointer -frename-registers -ggdb -feliminate-unused-debug-types"

PREFERRED_PROVIDER_virtual/kernel = "linux-fab4"

MACHINE_FEATURES = "kernel26 alsa screen"

KERNEL_IMAGETYPE = "zImage"

IMAGE_FSTYPES ?= "cramfs ubi tar.gz"

IMAGE_UBI_MIN_IO_SIZE ?= "2048"
IMAGE_UBI_PEB_SIZE ?= "131072"
IMAGE_UBI_SUB_PAGE_SIZE ?= "512"
IMAGE_UBI_CONFIG ?= "[kernel]\\n\
mode=ubi\\n\
image=${DEPLOY_DIR_IMAGE}/zImage-fab4.bin\\n\
vol_id=0\\n\
vol_size=2MiB\\n\
vol_type=static\\n\
vol_name=kernel\\n\
vol_alignment=1\\n\
\\n\
[cramfs]\\n\
mode=ubi\\n\
image=${DEPLOY_DIR_IMAGE}/squeezeos-image-fab4.cramfs\\n\
vol_id=1\\n\
vol_size=40MiB\\n\
vol_type=static\\n\
vol_name=cramfs\\n\
vol_alignment=1\\n\
\\n\
[ubifs]\\n\
mode=ubi\\n\
vol_id=2\\n\
vol_size=20MiB\\n\
vol_type=dynamic\\n\
vol_name=ubifs\\n\
vol_alignment=1\\n\
\\n\
"

SERIAL_CONSOLE = "-L 115200 tts/0"

IMAGE_INSTALL += "jivetest"
IMAGE_INSTALL += "marvell-sdio-module marvell-wlan-tools marvell-wps"
IMAGE_INSTALL += "snd-usb-hiface"

IMAGE_INSTALL += "squeezeplay-fab4"
IMAGE_INSTALL += "squeezeplay-fab4skin"
IMAGE_INSTALL += "squeezeplay-squeezeos"
IMAGE_INSTALL += "squeezeplay-fab4-bin"

IMAGE_INSTALL += "squeezelite"

IMAGE_INSTALL += "openvpn"
IMAGE_INSTALL += "samba"
IMAGE_INSTALL += "dhcp-forwarder"
IMAGE_INSTALL += "ntfs-3g"

IMAGE_SQUEEZEOS_UPGRADE = "1"
IMAGE_SQUEEZEOS_BOARD_VERSION = "fab4:0002\\n\
fab4:0003\\n\
fab4:0004\\n\
fab4:0005\\n\
fab4:0006\\n\
"

require conf/machine/include/tune-arm1136jf-s.inc
```

## poky/meta-squeezeos/conf/machine/jive.conf
```bitbake
#@TYPE: Machine
#@NAME: Logitech Squeezebox Controller (Jive)
#@DESCRIPTION: Machine configuration for the Logitech Squeezebox Controller
TARGET_ARCH = "arm"
PACKAGE_EXTRA_ARCHS = "armv4 armv4t armv5te"

# FIXME jive does not appear to like thumb
ARM_INSTRUCTION_SET = "arm"

PREFERRED_PROVIDER_virtual/kernel = "linux-jive"

MACHINE_FEATURES = "kernel26 alsa screen"

KERNEL_IMAGETYPE = "zImage"

IMAGE_FSTYPES ?= "cramfs tar.gz"
SERIAL_CONSOLE = "-L 115200 tts/0"

IMAGE_INSTALL += "uboot-env"
IMAGE_INSTALL += "jivetest"
IMAGE_INSTALL += "marvell-gspi-module marvell-wlan-tools marvell-wps"

IMAGE_INSTALL += "squeezeplay-jive"
IMAGE_INSTALL += "squeezeplay-qvgaskin squeezeplay-jiveskin"
IMAGE_INSTALL += "squeezeplay-squeezeos"

# IMAGE_INSTALL += "squeezelite"

IMAGE_INSTALL += "openvpn"

IMAGE_SQUEEZEOS_UPGRADE = "1"
IMAGE_SQUEEZEOS_EXTRA_VERSION = "-P7"
IMAGE_SQUEEZEOS_BOARD_VERSION = "jive:0000\\n\
jive:0001\\n\
"

require conf/machine/include/tune-arm926ejs.inc
```
